## conf/layer.conf
```bitbake
# We have a conf and classes directory, add to BBPATH
BBPATH .= ":${LAYERDIR}"

# We have recipes-* directories, add to BBFILES
BBFILES += "${LAYERDIR}/recipes-*/*/*.bb \
	${LAYERDIR}/recipes-*/*/*.bbappend"

BBFILE_COLLECTIONS += "codechecker-wr"
BBFILE_PATTERN_codechecker-wr = "^${LAYERDIR}/"
BBFILE_PRIORITY_codechecker-wr = "10"

LAYERSERIES_COMPAT_codechecker-wr = "dunfell gatesgarth hardknott"

include wrlinux.conf
```
